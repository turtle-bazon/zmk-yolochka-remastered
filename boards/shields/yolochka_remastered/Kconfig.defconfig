## boards/shields/yolochka_remastered/Kconfig.defconfig
```kconfig
# Copyright (c) 2020 The ZMK Contributors
# SPDX-License-Identifier: MIT

if SHIELD_YOLOCHKA_REMASTERED

config ZMK_KEYBOARD_NAME
    default "YolochkaR"

config ZMK_SPLIT
	default n

config USB_DEVICE_PRODUCT
	default "YolochkaR"

config USB_DEVICE_VID
	default "0x0000"

config USB_DEVICE_PID
	default "0xFEED"

config USB_DEVICE_MANUFACTURER
	default "turtle"

endif
```

## boards/shields/yolochka_remastered/Kconfig.shield
```kconfig
 #
 # Copyright (c) 2020 The ZMK Contributors
 #
 # SPDX-License-Identifier: MIT
 #

config SHIELD_YOLOCHKA_REMASTERED
    def_bool $(shields_list_contains,yolochka_remastered)
```
